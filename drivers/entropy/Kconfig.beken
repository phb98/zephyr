## drivers/entropy/Kconfig.beken
```kconfig
# Copyright The Zephyr Project Contributors
# SPDX-License-Identifier: Apache-2.0

config ENTROPY_BEKEN_BK7258_TRNG
	bool "Beken BK7258 TRNG driver"
	default y
	depends on DT_HAS_BEKEN_BK7258_TRNG_ENABLED
	select ENTROPY_HAS_DRIVER
	help
	  This option enables the true random number generator of the Beken
	  BK7258.
```

## drivers/flash/Kconfig.beken
```kconfig
# Copyright The Zephyr Project Contributors
# SPDX-License-Identifier: Apache-2.0

DT_BK7258_FC := $(DT_COMPAT_BEKEN_BK7258_FLASH_CONTROLLER)

config FLASH_BEKEN_BK7258
	bool "Beken BK7258 flash driver"
	default y
	depends on DT_HAS_BEKEN_BK7258_FLASH_CONTROLLER_ENABLED
	select FLASH_HAS_DRIVER_ENABLED
	select FLASH_HAS_EXPLICIT_ERASE
	select FLASH_HAS_PAGE_LAYOUT
	help
	  This option enables the Beken BK7258 flash driver.

if FLASH_BEKEN_BK7258

choice FLASH_BEKEN_BK7258_MODE
	prompt "Flash SPI mode"
	default FLASH_BEKEN_BK7258_MODE_DUAL
	help
	  Line mode of flash reads, execute-in-place included, set when the
	  driver initializes. Until then reads are single line. Dual is the
	  default where the flash controller node allows it.

config FLASH_BEKEN_BK7258_MODE_SINGLE
	bool "Single"

config FLASH_BEKEN_BK7258_MODE_DUAL
	bool "Dual"
	depends on $(dt_compat_any_has_prop,$(DT_BK7258_FC),spi-bus-width,2) || \
		   $(dt_compat_any_has_prop,$(DT_BK7258_FC),spi-bus-width,4)
	help
	  Needs spi-bus-width 2 or 4 on the flash controller node.

config FLASH_BEKEN_BK7258_MODE_QUAD
	bool "Quad"
	depends on $(dt_compat_any_has_prop,$(DT_BK7258_FC),spi-bus-width,4)
	depends on $(dt_compat_any_has_prop,$(DT_BK7258_FC),quad-enable-requirements)
	depends on !$(dt_compat_any_has_prop,$(DT_BK7258_FC),quad-enable-requirements,S2B7)
	depends on $(dt_compat_any_has_prop,$(DT_BK7258_FC),quad-mode-bits)
	help
	  Needs spi-bus-width 4, quad-enable-requirements other than S2B7 and
	  quad-mode-bits on the flash controller node, and the flash's quad
	  enable bit set; with the bit clear, reads are dual. A core reset,
	  such as sys_reboot(), leaves the flash in a state the BootROM cannot
	  boot from, until a reset by the reset pin or a power cycle.

endchoice

endif # FLASH_BEKEN_BK7258
```

## drivers/gpio/Kconfig.beken
```kconfig
# Copyright The Zephyr Project Contributors
# SPDX-License-Identifier: Apache-2.0

config GPIO_BEKEN_BK7258
	bool "Beken BK7258 GPIO driver"
	default y
	depends on DT_HAS_BEKEN_BK7258_GPIO_ENABLED
	help
	  This option enables the Beken BK7258 GPIO driver.
```

## drivers/spi/Kconfig.beken
```kconfig
# Copyright The Zephyr Project Contributors
# SPDX-License-Identifier: Apache-2.0

config SPI_BEKEN_BK7258
	bool "Beken BK7258 SPI driver"
	default y
	depends on DT_HAS_BEKEN_BK7258_SPI_ENABLED
	select PINCTRL
	help
	  This option enables the Beken BK7258 SPI driver.
```

## dts/bindings/clock/beken,bk7258-cgu.yaml
```yaml
# Copyright The Zephyr Project Contributors
# SPDX-License-Identifier: Apache-2.0

description: |
  Beken BK7258 clock generation unit (CGU).

  The clock controller in the SYS block. It gates the peripheral clocks and
  selects the source and divider of the clocks derived from the crystal and
  the PLLs.

  Two register regions: "cgu", the selects, dividers and gates, and "ana",
  the analog SPI status word followed by the analog registers that hold the
  DPLL and core-voltage settings.

  "clocks" is the source the core clock is taken from, either the crystal or
  one output of the beken,bk7258-dpll node. "clock-frequency" is the rate CPU0
  ends up running at: the source divided by core-prescaler, then by
  cpu0-prescaler. The driver programs what this node says and raises VDDDIG
  first when the source is the DPLL.

  Only the crystal undivided, which is what the BootROM leaves, and the
  480 MHz DPLL output with core-prescaler = <2> have been run on hardware.

  The clock specifier has one cell, the clock ID. Clock IDs are defined in
  include/zephyr/dt-bindings/clock/beken_bk7258_clock.h.

compatible: "beken,bk7258-cgu"

include: [clock-controller.yaml, base.yaml]

properties:
  reg:
    required: true

  reg-names:
    required: true

  clocks:
    required: true

  clock-frequency:
    type: int
    required: true
    description: |
      The rate CPU0 runs at once this node is programmed, in Hz. It must equal
      the source rate divided by core-prescaler and then by cpu0-prescaler,
      and the clock-frequency of /cpus/cpu@0; the build fails otherwise.

  core-prescaler:
    type: int
    required: true
    enum: [1, 2, 3, 4, 5, 6, 7, 8, 9, 10, 11, 12, 13, 14, 15, 16]
    description: |
      Divider from the source to the core and bus clock. The bus clock tops
      out at 240 MHz, so the 480 MHz DPLL output needs at least 2 here.

  cpu0-prescaler:
    type: int
    required: true
    enum: [1, 2]
    description: |
      Divider from the core clock to CPU0. CPU0 tops out at 240 MHz.

  "#clock-cells":
    const: 1

clock-cells:
  - id

examples:
  - |
    /* CPU0 at 240 MHz: the 480 MHz DPLL output halved */
    &dpll {
        status = "okay";
    };

    &cgu {
        clocks = <&dpll BK7258_DPLL_480M>;
        clock-frequency = <DT_FREQ_M(240)>;
        core-prescaler = <2>;
        cpu0-prescaler = <1>;
    };

    uart0: serial@44820000 {
        compatible = "beken,bk7258-uart";
        reg = <0x44820000 0x100>;
        clocks = <&cgu BK7258_CLK_UART0>;
    };
```

## dts/bindings/clock/beken,bk7258-dpll.yaml
```yaml
# Copyright The Zephyr Project Contributors
# SPDX-License-Identifier: Apache-2.0

description: |
  Beken BK7258 DPLL.

  The digital PLL, driven by the crystal. It has two fixed outputs,
  320 MHz and 480 MHz, and the clock specifier's single cell selects between
  them. The BootROM leaves it powered down; the clock controller brings it up
  when it is the core clock's source.

  Enabling this node does not by itself start the DPLL. Something has to
  select one of its outputs, as the clock controller's "clocks" property does.

compatible: "beken,bk7258-dpll"

include: [clock-controller.yaml, base.yaml]

properties:
  "#clock-cells":
    const: 1

  clocks:
    required: true

clock-cells:
  - output
```

## dts/bindings/flash_controller/beken,bk7258-flash-controller.yaml
```yaml
# Copyright The Zephyr Project Contributors
# SPDX-License-Identifier: Apache-2.0

description: Beken BK7258 flash controller

compatible: "beken,bk7258-flash-controller"

include: ["flash-controller.yaml", "jedec,spi-nor-common.yaml"]

properties:
  spi-bus-width:
    type: int
    enum:
      - 1
      - 2
      - 4
    description: |
      Number of data lines the flash can be read on. Dual reads need 2 or 4,
      quad reads needs 4.

  quad-mode-bits:
    type: int
    description: |
      Mode bits sent after the address of a quad read. The controller's quad
      reads leave out the opcode after the first, so these must put the
      flash in continuous read: 0xa0 on GigaDevice and Winbond parts.
```

## dts/bindings/gpio/beken,bk7258-gpio.yaml
```yaml
# Copyright The Zephyr Project Contributors
# SPDX-License-Identifier: Apache-2.0

title: Beken BK7258 GPIO port

description: gpio0 is pads 0 to 31, gpio1 is pads 32 to 55.

compatible: "beken,bk7258-gpio"

include: [gpio-controller.yaml, base.yaml]

properties:
  reg:
    required: true

  reg-names:
    required: true

  interrupts:
    required: true

  "#gpio-cells":
    const: 2

gpio-cells:
  - pin
  - flags
```

## dts/bindings/rng/beken,bk7258-trng.yaml
```yaml
# Copyright The Zephyr Project Contributors
# SPDX-License-Identifier: Apache-2.0

title: Beken BK7258 true random number generator

description: Hardware random number generator; every read of its data register returns a new word.

compatible: "beken,bk7258-trng"

include: base.yaml

properties:
  reg:
    required: true
```

## dts/bindings/spi/beken,bk7258-spi.yaml
```yaml
# Copyright The Zephyr Project Contributors
# SPDX-License-Identifier: Apache-2.0

description: Beken BK7258 SPI controller

compatible: "beken,bk7258-spi"

include: [spi-controller.yaml, pinctrl-device.yaml]

properties:
  reg:
    required: true

  interrupts:
    required: true

  clocks:
    required: true

  pinctrl-0:
    required: true

  pinctrl-names:
    required: true
```

## tests/drivers/spi/spi_loopback/boards/nicemcu_wb5e_bk7258_cpu0.conf
```kconfig
# Copyright The Zephyr Project Contributors
# SPDX-License-Identifier: Apache-2.0

CONFIG_SPI_ASYNC=n
```
